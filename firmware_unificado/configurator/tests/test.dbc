VERSION ""

NS_ :

BS_:

BU_:

BO_ 100 EngineData: 8 Vector__XXX
 SG_ EngineSpeed : 0|16@1+ (1,0) [0|8000] "rpm" Vector__XXX
 SG_ CoolantTemp : 16|8@1- (1,-40) [-40|215] "degC" Vector__XXX

BO_ 200 WheelSpeeds: 8 Vector__XXX
 SG_ FL_WheelSpeed : 0|16@1+ (0.1,0) [0|300] "km/h" Vector__XXX
 SG_ FR_WheelSpeed : 16|16@1+ (0.1,0) [0|300] "km/h" Vector__XXX
